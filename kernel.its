## kernel.its
```
/dts-v1/;

/ {
	description = "breadbee dev";
	#address-cells = <1>;

	images {
		kernel@0 {
			data = /incbin/("linux/arch/arm/boot/zImage");
			type = "kernel";
			arch = "arm";
			os = "linux";
			compression = "none";
			load = <0x22800000>;
                        entry = <0x22800000>;
			hash@1 {
				algo = "crc32";
			};
			hash@2 {
				algo = "sha1";
			};
		};
		fdt@0 {
			data = /incbin/("linux/arch/arm/boot/dts/infinity3-msc313e-breadbee.dtb");
			type = "flat_dt";
			arch = "arm";
			compression = "none";
			load = <0x22c00000>;
			hash@1 {
				algo = "crc32";
			};
			hash@2 {
				algo = "sha1";
			};
		};
		fdt@1 {
			data = /incbin/("linux/arch/arm/boot/dts/infinity-msc313-breadbee_crust.dtb");
			type = "flat_dt";
			arch = "arm";
			compression = "none";
			load = <0x22c00000>;
			hash@1 {
				algo = "crc32";
			};
			hash@2 {
				algo = "sha1";
			};
		};
		fdt@2 {
			data = /incbin/("linux/arch/arm/boot/dts/infinity3-msc313e-wiibee.dtb");
			type = "flat_dt";
			arch = "arm";
			compression = "none";
			load = <0x22c00000>;
			hash@1 {
				algo = "crc32";
			};
			hash@2 {
				algo = "sha1";
			};
		};
		fdt@3 {
			data = /incbin/("linux/arch/arm/boot/dts/mercury5-ssc8336n-midrive08.dtb");
			type = "flat_dt";
			arch = "arm";
			compression = "none";
			load = <0x22c00000>;
			hash@1 {
				algo = "crc32";
			};
			hash@2 {
				algo = "sha1";
			};
		};
		fdt@4 {
			data = /incbin/("linux/arch/arm/boot/dts/mercury5-ssc8336-mirrorcam.dtb");
			type = "flat_dt";
			arch = "arm";
			compression = "none";
			load = <0x22c00000>;
			hash@1 {
				algo = "crc32";
			};
			hash@2 {
				algo = "sha1";
			};
		};
		ramdisk@0 {
			data = /incbin/("../breadbee_buildroot/buildroot_rescue/output/images/rootfs.cpio");
                        type = "ramdisk";
                        arch = "arm";
			os = "linux";
                        compression = "none";
                        load = <0x22d00000>;
                        hash@1 {
                                algo = "crc32";
                        };
                        hash@2 {
                                algo = "sha1";
                        };
		};
		///include/ "../breadbee_buildroot/buildroot/output/images/breadbee-overlays/fdtlist"
	};

	configurations {
		default = "breadbee";
		breadbee {
			kernel = "kernel@0";
			fdt = "fdt@0";
		};
		breadbee_crust {
			kernel = "kernel@0";
			fdt = "fdt@1";
		};
		wiibee {
			kernel = "kernel@0";
			fdt = "fdt@2";
		};
		midrive08 {
			kernel = "kernel@0";
			fdt = "fdt@3";
			ramdisk = "ramdisk@0";
		};
		mirrorcam {
			kernel = "kernel@0";
			fdt = "fdt@4";
			ramdisk = "ramdisk@0";
		};
		midrive08_nrd {
			kernel = "kernel@0";
			fdt = "fdt@3";
		};
		///include/ "../breadbee_buildroot/buildroot/output/images/breadbee-overlays/configlist"
	};
};
```

## kernel_m5.its
```
/dts-v1/;

/ {
	description = "breadbee dev";
	#address-cells = <1>;

	images {
		kernel@0 {
			data = /incbin/("linux/arch/arm/boot/zImage");
			type = "kernel";
			arch = "arm";
			os = "linux";
			compression = "none";
			load = <0x22800000>;
                        entry = <0x22800000>;
			hash@1 {
				algo = "crc32";
			};
			hash@2 {
				algo = "sha1";
			};
		};
		fdt@0 {
			data = /incbin/("linux/arch/arm/boot/dts/mercury5-ssc8336n-midrived06.dtb");
			type = "flat_dt";
			arch = "arm";
			compression = "none";
			load = <0x22d00000>;
			hash@1 {
				algo = "crc32";
			};
			hash@2 {
				algo = "sha1";
			};
		};
		fdt@1 {
			data = /incbin/("linux/arch/arm/boot/dts/mercury5-ssc8336n-midrived08.dtb");
			type = "flat_dt";
			arch = "arm";
			compression = "none";
			load = <0x22d00000>;
			hash@1 {
				algo = "crc32";
			};
			hash@2 {
				algo = "sha1";
			};
		};
		fdt@2 {
			data = /incbin/("linux/arch/arm/boot/dts/mercury5-ssc8336-mirrorcam.dtb");
			type = "flat_dt";
			arch = "arm";
			compression = "none";
			load = <0x22d00000>;
			hash@1 {
				algo = "crc32";
			};
			hash@2 {
				algo = "sha1";
			};
		};
		ramdisk@0 {
			data = /incbin/("m5buildroot/buildroot/output/images/rootfs.cpio.gz");
                        type = "ramdisk";
                        arch = "arm";
			os = "linux";
                        compression = "none";
                        load = <0x22e00000>;
                        hash@1 {
                                algo = "crc32";
                        };
                        hash@2 {
                                algo = "sha1";
                        };
		};
	};

	configurations {
		default = "midrive06";
		midrived06 {
			kernel = "kernel@0";
			fdt = "fdt@0";
			ramdisk = "ramdisk@0";
		};
		midrived08 {
			kernel = "kernel@0";
			fdt = "fdt@1";
			ramdisk = "ramdisk@0";
		};
		mirrorcam {
			kernel = "kernel@0";
			fdt = "fdt@2";
			ramdisk = "ramdisk@0";
		};
		midrived08_nrd {
			kernel = "kernel@0";
			fdt = "fdt@1";
		};
	};
};
```

## kernel_ssd20xd.its
```
/dts-v1/;

/ {
	description = "Sigmastar SSD20XD machines";
	#address-cells = <1>;

	images {
		kernel@0 {
			data = /incbin/("linux/arch/arm/boot/zImage");
			type = "kernel";
			arch = "arm";
			os = "linux";
			compression = "none";
			load = <0x22800000>;
                        entry = <0x22800000>;
			hash@1 {
				algo = "crc32";
			};
			hash@2 {
				algo = "sha1";
			};
		};
		fdt@0 {
			data = /incbin/("linux/arch/arm/boot/dts/mstar-infinity2m-ssd201-som2d01.dtb");
			type = "flat_dt";
			arch = "arm";
			compression = "none";
			load = <0x22d00000>;
			hash@1 {
				algo = "crc32";
			};
			hash@2 {
				algo = "sha1";
			};
		};
		fdt@1 {
			data = /incbin/("linux/arch/arm/boot/dts/mstar-infinity2m-ssd202d-som2d01.dtb");
			type = "flat_dt";
			arch = "arm";
			compression = "none";
			load = <0x22d00000>;
			hash@1 {
				algo = "crc32";
			};
			hash@2 {
				algo = "sha1";
			};
		};
		fdt@2 {
			data = /incbin/("linux/arch/arm/boot/dts/mstar-infinity2m-ssd202d-gw302.dtb");
			type = "flat_dt";
			arch = "arm";
			compression = "none";
			load = <0x22d00000>;
			hash@1 {
				algo = "crc32";
			};
			hash@2 {
				algo = "sha1";
			};
		};
		fdt@3 {
			data = /incbin/("linux/arch/arm/boot/dts/mstar-infinity2m-ssd202d-ssd201htv2.dtb");
			type = "flat_dt";
			arch = "arm";
			compression = "none";
			load = <0x22d00000>;
			hash@1 {
				algo = "crc32";
			};
			hash@2 {
				algo = "sha1";
			};
		};
		fdt@4 {
			data = /incbin/("linux/arch/arm/boot/dts/mstar-infinity2m-ssd202d-unitv2.dtb");
			type = "flat_dt";
			arch = "arm";
			compression = "none";
			load = <0x22d00000>;
			hash@1 {
				algo = "crc32";
			};
			hash@2 {
				algo = "sha1";
			};
		};
		ramdisk@0 {
			data = /incbin/("m5buildroot/buildroot/output/images/rootfs.cpio.gz");
			type = "ramdisk";
			arch = "arm";
			os = "linux";
			compression = "none";
			load = <0x22e00000>;
			hash@1 {
				algo = "crc32";
			};
			hash@2 {
				algo = "sha1";
			};
		};
	};

	configurations {
		default = "som2d01_ssd201";
		som2d01_ssd201 {
			kernel = "kernel@0";
			fdt = "fdt@0";
			ramdisk = "ramdisk@0";
		};
		som2d01_ssd202 {
			kernel = "kernel@0";
			fdt = "fdt@1";
			ramdisk = "ramdisk@0";
		};
		gw302 {
			kernel = "kernel@0";
			fdt = "fdt@2";
			ramdisk = "ramdisk@0";
		};
		gw302_nord {
			kernel = "kernel@0";
			fdt = "fdt@2";
		};
		ssd201htv2 {
			kernel = "kernel@0";
			fdt = "fdt@3";
			ramdisk = "ramdisk@0";
		};
	};
};
```
